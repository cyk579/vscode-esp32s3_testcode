## esp-projects/VScode ESP/VScode ESP/sdkconfig.defaults
```kconfig
#
# PSRAM（摄像头帧缓冲和 JPEG 解码缓冲需要）
#
CONFIG_SPIRAM=y
CONFIG_SPIRAM_MODE_OCT=y
CONFIG_SPIRAM_SPEED_80M=y
CONFIG_SPIRAM_MALLOC_RESERVE_INTERNAL=150000

#
# CPU
#
CONFIG_ESP_DEFAULT_CPU_FREQ_MHZ_240=y

#
# USB Host（UVC 摄像头）
#
CONFIG_USB_HOST_CONTROL_TRANSFER_MAX_SIZE=3000
CONFIG_USB_HOST_HW_BUFFER_BIAS_IN=y
```

## esp-projects/camera-claude/sdkconfig.defaults.esp32s3
```kconfig
#
# SPIRAM
#
CONFIG_SPIRAM_SPEED_80M=y
CONFIG_SPIRAM_MODE_OCT=y
CONFIG_SPIRAM_TYPE_AUTO=y

# ESP32-S3-WROOM-2-N32R16V fitted on this board.
CONFIG_ESPTOOLPY_OCT_FLASH=y
CONFIG_ESPTOOLPY_FLASHMODE_OPI=y
CONFIG_ESPTOOLPY_FLASHSIZE_32MB=y

# 与本仓库 camera-test 的 N32R16V 配置一致；80MHz为本工程选定频率。
CONFIG_ESPTOOLPY_FLASHFREQ_80M=y
CONFIG_ESPTOOLPY_FLASH_SAMPLE_MODE_DTR=y
CONFIG_SPI_FLASH_OCTAL_32BIT_ADDR_ENABLE=y

# 保留现有欠压检测设置，不用更改阈值来掩盖供电问题。
# 实际阈值以当前 ESP-IDF 的 menuconfig 为准。
CONFIG_ESP_BROWNOUT_DET=y
CONFIG_ESP_BROWNOUT_DET_LVL_SEL_7=y

CONFIG_ESP_CONSOLE_UART_DEFAULT=y
# USB副控制台仅在USB PHY被摄像头接管前可用；运行日志走UART0。
# CONFIG_ESP_CONSOLE_SECONDARY_NONE is not set
CONFIG_ESP_CONSOLE_SECONDARY_USB_SERIAL_JTAG=y
CONFIG_ESP_CONSOLE_USB_SERIAL_JTAG_ENABLED=y

#
# SYSTEM
#
CONFIG_ESP_DEFAULT_CPU_FREQ_MHZ_240=y
```

## esp-projects/camera-test/main/Kconfig.projbuild
```kconfig
menu "Example Configuration"
    config EXAMPLE_ENABLE_STREAMING
        bool "Enable streaming"
        default n
        help
            Enables streaming of captured video.

    config EXAMPLE_WIFI_USE_STA
        bool "Join an existing Wi-Fi network for streaming"
        default n
        depends on EXAMPLE_ENABLE_STREAMING
        help
            Use station mode instead of creating an ESP32 access point. This
            keeps the PC on its normal network, so internet access is not
            interrupted while the camera stream is viewed.

    config EXAMPLE_WIFI_STA_SSID
        string "Existing Wi-Fi SSID"
        default ""
        depends on EXAMPLE_ENABLE_STREAMING && EXAMPLE_WIFI_USE_STA

    config EXAMPLE_WIFI_STA_PASSWORD
        string "Existing Wi-Fi password"
        default ""
        depends on EXAMPLE_ENABLE_STREAMING && EXAMPLE_WIFI_USE_STA

    config EXAMPLE_ENABLE_TFT_PREVIEW
        bool "Enable TFT status page"
        default y
        help
            Enables the low-rate ST7735 color camera preview with status text
            and line overlay. Preview runs in a low-priority task and never
            blocks camera control; disable it for maximum competition speed.

    config EXAMPLE_ENABLE_CAMERA_LINE_FOLLOW
        bool "Enable camera black-line following"
        default y
        depends on !EXAMPLE_ENABLE_SERVO_TEST
        help
            Decodes each UVC MJPEG frame and drives the three-wheel TB6612
            vehicle from the black-line position.  The motors remain in
            standby until a line is confirmed for several frames.

    config EXAMPLE_ENABLE_ENCODERS
        bool "Enable wheel encoder telemetry"
        default y
        depends on EXAMPLE_ENABLE_CAMERA_LINE_FOLLOW
        help
            Read the three quadrature wheel encoders for diagnostics only.
            Encoder values are not used to change motor commands until the
            wheel direction and counts-per-revolution have been calibrated.

    config EXAMPLE_ENCODER_SAMPLE_PERIOD_MS
        int "Encoder sample period (ms)"
        range 5 1000
        default 10
        depends on EXAMPLE_ENABLE_ENCODERS
        help
            Time between PCNT snapshots.  Ten milliseconds gives useful
            low-speed telemetry without adding load to the camera task.

    config EXAMPLE_ENCODER_COUNTS_PER_REV
        int "Encoder counts per revolution"
        range 1 100000
        default 1
        depends on EXAMPLE_ENABLE_ENCODERS
        help
            Counts per wheel revolution used in the diagnostic report.  The
            default is intentionally uncalibrated; measure it on the vehicle.

    config EXAMPLE_ENCODER_A_INVERT
        bool "Invert Motor A encoder direction"
        default n
        depends on EXAMPLE_ENABLE_ENCODERS

    config EXAMPLE_ENCODER_B_INVERT
        bool "Invert Motor B encoder direction"
        default n
        depends on EXAMPLE_ENABLE_ENCODERS

    config EXAMPLE_ENCODER_D_INVERT
        bool "Invert Motor D encoder direction"
        default n
        depends on EXAMPLE_ENABLE_ENCODERS

    config EXAMPLE_ENABLE_SERVO_TEST
        bool "Run servo test at startup"
        default n
        help
            Runs the short pan/tilt servo movement test before USB Host starts.
            Keep this disabled when the servos are not powered from a separate
            stable 5 V supply.

    choice EXAMPLE_UVC_PROTOCOL_MODE
        prompt "UVC Protocol mode"
        default EXAMPLE_UVC_PROTOCOL_MODE_AUTO

        config EXAMPLE_UVC_PROTOCOL_MODE_AUTO
            bool "Auto"
            help
                When protocol mode is Auto, the example tries five profiles in
                this order (each profile is retried as configured below):
                1 Attempt: 320x240, 30 FPS, MJPEG
                2 Attempt: 480x320, 25 FPS, MJPEG
                3 Attempt: 480x320, first available FPS, MJPEG
                4 Attempt: 640x480, 15 FPS, MJPEG
                5 Attempt: 1280x720, first available FPS, MJPEG
                If all five attempts result in an error, the example displays the error message and
                suggests to try another USB UVC Device.

        config EXAMPLE_UVC_PROTOCOL_MODE_CUSTOM
            bool "Custom"
            help
                When protocol mode set to Custom, the example tries to negotiate protocol with
                configured parameters: Attempts, Width, Height, FPS, Frame Coding format.
                After all attempts result in an error, the example displays the error message and
                suggests to try another USB UVC Device.

    endchoice

    config EXAMPLE_NEGOTIATION_ATTEMPTS
        int "Negotiation attempts"
        default 3
        help
            Number of attempts to negotiate custom protocol parameters.

    menu "UVC Protocol parameters"
        depends on EXAMPLE_UVC_PROTOCOL_MODE_CUSTOM

        config EXAMPLE_WIDTH_PARAM
            int "Width resolution in pixels"
            default 320
            help
                Configure the negotiation width parameter during UVC device stream getting.
        config EXAMPLE_HEIGHT_PARAM
            int "Height resolution in pixels"
            default 240
            help
                Configure the negotiation height parameter during UVC device stream getting.
        config EXAMPLE_FPS_PARAM
            int "FPS"
            default 30
            help
                Configure the negotiation FPS parameter during UVC device stream getting.
                Can be any value, available from the Frame Descriptor of the UVC device.
                When 0 - negotiation accept the first rate available.

        choice EXAMPLE_NEGOTIATION_FORMAT
            prompt "Frame coding format of the stream, transport-independent"
            default UVC_FRAME_FORMAT_MJPEG
            help
                Configure the negotiation frame coding of stream.

            config UVC_FRAME_FORMAT_UNKNOWN
                bool "Unknown"
            config UVC_FRAME_FORMAT_UNCOMPRESSED
                bool "Uncompressed"
            config UVC_FRAME_FORMAT_COMPRESSED
                bool "Compressed"
            config UVC_FRAME_FORMAT_YUYV
                bool "YUYV"
            config UVC_FRAME_FORMAT_UYVY
                bool "UYVY"
            config UVC_FRAME_FORMAT_RGB
                bool "RGB"
            config UVC_FRAME_FORMAT_BGR
                bool "BGR"
            config UVC_FRAME_FORMAT_MJPEG
                bool "MJPEG"
            config UVC_FRAME_FORMAT_GRAY8
                bool "GRAY8"
            config UVC_FRAME_FORMAT_GRAY16
                bool "GRAY16"
            config UVC_FRAME_FORMAT_NV12
                bool "NV12"

        endchoice

        config EXAMPLE_FORMAT_PARAM
            int
            default 0  if UVC_FRAME_FORMAT_UNKNOWN
            default 1  if UVC_FRAME_FORMAT_UNCOMPRESSED
            default 2  if UVC_FRAME_FORMAT_COMPRESSED
            default 3  if UVC_FRAME_FORMAT_YUYV
            default 4  if UVC_FRAME_FORMAT_UYVY
            default 5  if UVC_FRAME_FORMAT_RGB
            default 6  if UVC_FRAME_FORMAT_BGR
            default 7  if UVC_FRAME_FORMAT_MJPEG
            default 9  if UVC_FRAME_FORMAT_GRAY8
            default 10 if UVC_FRAME_FORMAT_GRAY16
            default 17 if UVC_FRAME_FORMAT_NV12
    endmenu

endmenu
```

## esp-projects/camera-test/sdkconfig.defaults.esp32s3
```kconfig
#
# SPIRAM
#
CONFIG_SPIRAM_SPEED_80M=y
CONFIG_SPIRAM_MODE_OCT=y
CONFIG_SPIRAM_TYPE_AUTO=y

# ESP32-S3-WROOM-2-N32R16V fitted on this board.
CONFIG_ESPTOOLPY_OCT_FLASH=y
CONFIG_ESPTOOLPY_FLASHMODE_OPI=y
CONFIG_ESPTOOLPY_FLASHSIZE_32MB=y

# Keep USB logs available during the 15-second diagnostic window.
# CONFIG_ESP_CONSOLE_SECONDARY_NONE is not set
CONFIG_ESP_CONSOLE_SECONDARY_USB_SERIAL_JTAG=y
CONFIG_ESP_CONSOLE_USB_SERIAL_JTAG_ENABLED=y

#
# SYSTEM
#
CONFIG_ESP_DEFAULT_CPU_FREQ_MHZ_240=y
```

## esp-projects/gesture-car/sdkconfig.defaults
```kconfig
# Default hardware: ESP32-S3-WROOM-2-N32R16V. Verify handheld module separately.
CONFIG_IDF_TARGET="esp32s3"
CONFIG_BT_ENABLED=y
CONFIG_BT_BLUEDROID_ENABLED=n
CONFIG_BT_NIMBLE_ENABLED=y
CONFIG_BT_NIMBLE_MAX_CONNECTIONS=1
CONFIG_BT_NIMBLE_ROLE_CENTRAL=y
CONFIG_BT_NIMBLE_ROLE_PERIPHERAL=y
CONFIG_BT_NIMBLE_ROLE_OBSERVER=y
CONFIG_BT_NIMBLE_ROLE_BROADCASTER=y
CONFIG_FREERTOS_HZ=1000
CONFIG_ESP_DEFAULT_CPU_FREQ_MHZ_240=y
CONFIG_ESPTOOLPY_OCT_FLASH=y
CONFIG_ESPTOOLPY_FLASHMODE_OPI=y
CONFIG_ESPTOOLPY_FLASH_SAMPLE_MODE_DTR=y
CONFIG_ESPTOOLPY_FLASHFREQ_80M=y
CONFIG_ESPTOOLPY_FLASHSIZE_32MB=y
CONFIG_SPI_FLASH_OCTAL_32BIT_ADDR_ENABLE=y
CONFIG_ESP_CONSOLE_UART_DEFAULT=y
CONFIG_PARTITION_TABLE_SINGLE_APP_LARGE=y
```

## esp-projects/gesture-common/Kconfig
```kconfig
menu "Gesture experiment"
config GESTURE_GROUP_ID
    int "Car/remote group ID (same on both boards and Android)"
    range 1 65535
    default 1
endmenu
```

## esp-projects/subject2-camera/sdkconfig.defaults
```kconfig
#
# PSRAM（摄像头帧缓冲和 JPEG 解码缓冲需要）
#
CONFIG_SPIRAM=y
CONFIG_SPIRAM_MODE_OCT=y
CONFIG_SPIRAM_SPEED_80M=y
CONFIG_SPIRAM_MALLOC_RESERVE_INTERNAL=150000

# 本车 ESP32-S3-WROOM-2-N32R16V：32MB Octal Flash，80MHz DTR。
CONFIG_ESPTOOLPY_OCT_FLASH=y
CONFIG_ESPTOOLPY_FLASHMODE_OPI=y
CONFIG_ESPTOOLPY_FLASH_SAMPLE_MODE_DTR=y
CONFIG_ESPTOOLPY_FLASHFREQ_80M=y
CONFIG_ESPTOOLPY_FLASHSIZE_32MB=y
CONFIG_SPI_FLASH_OCTAL_32BIT_ADDR_ENABLE=y

# 摄像头使用 GPIO19/20 的 USB PHY，日志使用 UART0 TX=43/RX=44。
CONFIG_ESP_CONSOLE_UART_DEFAULT=y

#
# CPU
#
CONFIG_ESP_DEFAULT_CPU_FREQ_MHZ_240=y

#
# USB Host（UVC 摄像头）
#
CONFIG_USB_HOST_CONTROL_TRANSFER_MAX_SIZE=3000
CONFIG_USB_HOST_HW_BUFFER_BIAS_IN=y
```

## esp-projects/subject3-ASR/main/Kconfig.projbuild
```kconfig
menu "Subject3 ASR preparation"
choice SUBJECT3_MODE
    prompt "Application mode (speech recognition runs on the phone)"
    default SUBJECT3_BLE_BASELINE
config SUBJECT3_USB_MIC_PROBE
    bool "USB microphone diagnostics; motors disabled"
config SUBJECT3_BLE_BASELINE
    bool "BLE omni car; phone voice commands or joysticks"
endchoice
config SUBJECT3_MUSIC
    bool "USB UAC speaker and music filesystem"
    default y
    depends on SUBJECT3_BLE_BASELINE
    help
        Runs an independent PCM WAV player. No song is played at startup.
config SUBJECT3_SPEAKER_RATE
    int "Speaker and prepared WAV sample rate"
    range 8000 48000
    default 16000
config SUBJECT3_SPEAKER_GAIN
    int "PCM playback level (percent)"
    range 1 100
    default 100

config SUBJECT3_MIC_RATE
    int "Requested microphone sample rate (0 = any advertised rate)"
    range 0 48000
    default 0
    depends on SUBJECT3_USB_MIC_PROBE
    help
        First discover the device with 0. Then request 16000 to check
        native ESP-SR input compatibility. No resampling is performed.
config SUBJECT3_MIC_CHANNELS
    int "Requested channels (0 = any, 1 = mono, 2 = stereo)"
    range 0 2
    default 0
    depends on SUBJECT3_USB_MIC_PROBE
config SUBJECT3_MIC_BITS
    int "Requested bits per sample (0 = any; normally 16)"
    range 0 24
    default 0
    depends on SUBJECT3_USB_MIC_PROBE
    help
        Meter readings are computed only for 16-bit PCM.
        Values other than 0 must be between 8 and 24.
endmenu
```

## esp-projects/subject3-ASR/sdkconfig.defaults
```kconfig
# Same car hardware as gesture-car: ESP32-S3-WROOM-2-N32R16V.
CONFIG_IDF_TARGET="esp32s3"
CONFIG_BT_ENABLED=y
CONFIG_BT_BLUEDROID_ENABLED=n
CONFIG_BT_NIMBLE_ENABLED=y
CONFIG_BT_NIMBLE_MAX_CONNECTIONS=1
CONFIG_BT_NIMBLE_ROLE_CENTRAL=y
CONFIG_BT_NIMBLE_ROLE_PERIPHERAL=y
CONFIG_BT_NIMBLE_ROLE_OBSERVER=y
CONFIG_BT_NIMBLE_ROLE_BROADCASTER=y
CONFIG_FREERTOS_HZ=1000
CONFIG_ESP_DEFAULT_CPU_FREQ_MHZ_240=y
CONFIG_ESPTOOLPY_OCT_FLASH=y
CONFIG_ESPTOOLPY_FLASHMODE_OPI=y
CONFIG_ESPTOOLPY_FLASH_SAMPLE_MODE_DTR=y
CONFIG_ESPTOOLPY_FLASHFREQ_80M=y
CONFIG_ESPTOOLPY_FLASHSIZE_32MB=y
CONFIG_SPI_FLASH_OCTAL_32BIT_ADDR_ENABLE=y
CONFIG_ESP_CONSOLE_UART_DEFAULT=y
CONFIG_PARTITION_TABLE_CUSTOM=y
CONFIG_PARTITION_TABLE_CUSTOM_FILENAME="partitions.csv"
CONFIG_PARTITION_TABLE_FILENAME="partitions.csv"
# 24 MiB needs larger pages to fit SPIFFS 16-bit page/object indices.
CONFIG_SPIFFS_PAGE_SIZE=1024
CONFIG_SUBJECT3_BLE_BASELINE=y
CONFIG_SUBJECT3_MUSIC=y
CONFIG_SUBJECT3_SPEAKER_GAIN=100
CONFIG_UVC_GET_CONFIG_DESC=y
CONFIG_CTRL_TRANSFER_DATA_MAX_BYTES=2048
CONFIG_USB_HOST_CONTROL_TRANSFER_MAX_SIZE=3000
```
